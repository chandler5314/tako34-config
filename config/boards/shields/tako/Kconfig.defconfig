## config/boards/shields/tako/Kconfig.defconfig
```kconfig
if SHIELD_TAKO_LEFT

config ZMK_KEYBOARD_NAME
  default "SSY34"

endif


if ZMK_BATTERY_REPORTING

choice ZMK_BATTERY_REPORTING_FETCH_MODE
	default ZMK_BATTERY_REPORTING_FETCH_MODE_LITHIUM_VOLTAGE
endchoice

endif
```
