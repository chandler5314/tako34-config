## config/tako_drivers/bt_led_force/Kconfig
```kconfig
config TAKO_BT_LED_FORCE_ON
    bool "Tako Bluetooth LED force on"
    select GPIO
    default y if SHIELD_TAKO_LEFT
```

## config/tako_drivers/bt_status_led/Kconfig
```kconfig
config TAKO_BT_STATUS_LED
    bool "Tako Bluetooth status LED"
    depends on ZMK_BLE
    select GPIO
    default y if SHIELD_TAKO_LEFT
```

## config/tako_drivers/regout0_3v/Kconfig
```kconfig
config TAKO_REGOUT0_3V
    bool "Tako nRF52840 REGOUT0 3.0V setup"
    depends on SOC_NRF52840
    default y if SHIELD_TAKO_LEFT
```
